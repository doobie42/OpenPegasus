/dts-v1/;
/plugin/;

/ {
   compatible = "ti,beaglebone", "ti,beaglebone-black";

   part-number = "doobie";
   version = "00A0";

   /* This overlay uses the following resources */
   exclusive-use =
          //"P9.27", "P8.46", "P9.30",
	  "P9.28", "P9.29";//,  "pru0", "pru1";

   fragment@0 {
      target = <&am33xx_pinmux>;
      __overlay__ {

         pru_pru_pins: pinmux_pru_pru_pins {   // The PRU pin modes
            pinctrl-single,pins = <

				0x190 0x15 /*#define SCLK 0 //p9_31, MCASP0_ACLKX=990h, 190h*/
				0x194 0x15 /*#define DIN 1 // p9_29, MCASP0_FSX=994h, 194h*/
				0x19c 0x15 /*#define SYNC 3 // p9_28 */

			//	0x1a4 0x15 /*#define LDAC  5 // p9_27 */

				0x034 0x6 /*#define LASER 2 pull down */
				0x030 0x6 /*#define CURRENTONOFF 15 pull down*/

            >;
         };
      };
   };

   fragment@1 {         // Enable the PRUSS
      target = <&pruss>;
      __overlay__ {
         status = "okay";
         pinctrl-names = "default";
         pinctrl-0 = <&pru_pru_pins>;
      };
   };

};

